## drivers/huawei/ap_cp/Kconfig
```kconfig
config AP_CP_TIMEOUT
	tristate "Ap cp communication timeout."
    default y
    help
	  This module adds support for ap cp timeout processing based on
	  Balong V3R3 chipset.
```
