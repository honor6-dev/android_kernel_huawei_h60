/*
 * Hisilicon Ltd.
 *
 * A15x4 A7x4
 *
 * It is only a demo for hisilicon hi3630 board. You show change the
 * address of each node according to datasheet.
 */

/dts-v1/;


/include/ "PINE_TLGULG_V1_config.dtsi"
/include/ "hisi_3630_pin_PINE_TLGULG_V4_EMMC32G.dtsi"
/include/ "hisi_3630_modem_PINE_TLGULG_V4_EMMC32G.dtsi"
/ {
	board_info: board_info {
		hisi,boardid = <8 3 7>;
		hisi,boardname = "Pine_TLGULG_V4_EMMC32G";
		hisi,modem_id = <0x3FF59000>;
		hisi,config_profile = "high";
		hw,public;
	};
};
