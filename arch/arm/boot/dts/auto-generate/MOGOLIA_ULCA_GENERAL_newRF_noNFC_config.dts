/*
 * Hisilicon Ltd.
 *
 * A15x4 A7x4
 *
 * It is only a demo for hisilicon hi3630 board. You show change the
 * address of each node according to datasheet.
 */

/dts-v1/;


/include/ "MOGOLIA_ULCA_GENERAL_V3_noNFC_config.dtsi"
/include/ "hisi_3630_pin_MOGOLIA_ULCA_GENERAL_newRF_noNFC.dtsi"
/include/ "hisi_3630_modem_MOGOLIA_ULCA_GENERAL_newRF_noNFC.dtsi"
/ {
	board_info: board_info {
		hisi,boardid = <3 4 7>;
		hisi,boardname = "Mogolia_ULCA_GENERAL_newRF_noNFC";
		hisi,modem_id = <0x3fb09400>;
		hw,public;
	};
};
