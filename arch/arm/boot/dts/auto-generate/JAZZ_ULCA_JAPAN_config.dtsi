/*
 * Hisilicon Ltd.
 *
 * A15x4 A7x4
 *
 * It is only a demo for hisilicon hi3630 board. You show change the
 * address of each node according to datasheet.
 */



/include/ "JAZZ_ULCA_VN1_config.dtsi"
/include/ "hisi_3630_pin_JAZZ_ULCA_JAPAN.dtsi"
/include/ "hisi_3630_modem_JAZZ_ULCA_JAPAN.dtsi"
/ {
	board_info: board_info {
		hisi,boardid = <4 4 7>;
		hisi,boardname = "Jazz_UL+CA_JAPAN";
		hisi,modem_id = <0x3fb08400>;
		hw,public;
	};
};
